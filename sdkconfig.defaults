## sdkconfig.defaults
```kconfig
# ESP32-CAM GenICam Configuration Defaults
# ESP-IDF native configuration

# ESP32 CPU Configuration
CONFIG_ESP_DEFAULT_CPU_FREQ_MHZ_240=y
CONFIG_ESP_DEFAULT_CPU_FREQ_MHZ=240

# Flash Configuration
CONFIG_ESPTOOLPY_FLASHSIZE_4MB=y
CONFIG_ESPTOOLPY_FLASHSIZE="4MB"

# Partition Table
CONFIG_PARTITION_TABLE_CUSTOM=y
CONFIG_PARTITION_TABLE_CUSTOM_FILENAME="partitions.csv"

# Serial Console Configuration
CONFIG_ESP_CONSOLE_UART_DEFAULT=y
CONFIG_ESP_CONSOLE_UART_BAUDRATE=115200

# WiFi Configuration
CONFIG_ESP_WIFI_SSID="PCJV"
CONFIG_ESP_WIFI_PASSWORD="97750387953251457840"

# Memory Configuration for Camera
CONFIG_SPIRAM=y
CONFIG_SPIRAM_USE_CAPS_ALLOC=y
CONFIG_SPIRAM_USE_MALLOC=y

# FreeRTOS Configuration
CONFIG_FREERTOS_UNICORE=n
CONFIG_FREERTOS_HZ=1000

# Component Configuration
CONFIG_ESP_WIFI_ENABLED=y

# Logging Configuration
CONFIG_LOG_DEFAULT_LEVEL_INFO=y
CONFIG_LOG_MAXIMUM_LEVEL_DEBUG=y

# Network Configuration - Enhanced for Broadcast/Multicast Reception
CONFIG_LWIP_SO_RCVBUF=y

# Phase 2A: Enhanced LWIP Settings for Broadcast Reception
# Enable multicast support for better broadcast handling
CONFIG_LWIP_IGMP=y
CONFIG_LWIP_MULTICAST_PING=y

# Increased buffer sizes for broadcast reception (Phase 2A)
CONFIG_LWIP_UDP_RECVMBOX_SIZE=32
CONFIG_LWIP_TCPIP_RECVMBOX_SIZE=64

# Optimize for broadcast/multicast reception
CONFIG_LWIP_SO_REUSE=y
CONFIG_LWIP_SO_REUSE_RXTOALL=y

# Additional broadcast optimizations
CONFIG_LWIP_NETIF_LOOPBACK=y
CONFIG_LWIP_IPV4=y
CONFIG_LWIP_BROADCAST_PING=y

# Enhanced socket options for broadcast handling
CONFIG_LWIP_SOCKET_MULTITHREAD_SAFE=y
CONFIG_LWIP_MAX_SOCKETS=16

# Camera specific configurations (will be defined in main component)
# These are custom configs defined in our Kconfig files
CONFIG_CAMERA_PIN_PWDN=32
CONFIG_CAMERA_PIN_RESET=-1
CONFIG_CAMERA_PIN_XCLK=0
CONFIG_CAMERA_PIN_SIOD=26
CONFIG_CAMERA_PIN_SIOC=27
CONFIG_CAMERA_PIN_D7=35
CONFIG_CAMERA_PIN_D6=34
CONFIG_CAMERA_PIN_D5=39
CONFIG_CAMERA_PIN_D4=36
CONFIG_CAMERA_PIN_D3=21
CONFIG_CAMERA_PIN_D2=19
CONFIG_CAMERA_PIN_D1=18
CONFIG_CAMERA_PIN_D0=5
CONFIG_CAMERA_PIN_VSYNC=25
CONFIG_CAMERA_PIN_HREF=23
CONFIG_CAMERA_PIN_PCLK=22

# Status LED Configuration
CONFIG_STATUS_LED_GPIO=33
CONFIG_STATUS_LED_INVERTED=y

# Optional Features - Web Server enabled by default
CONFIG_ENABLE_WEB_SERVER=y

# Protocol Debug Logging - disabled by default for production
CONFIG_ENABLE_PROTOCOL_DEBUG_LOGS=n
```
